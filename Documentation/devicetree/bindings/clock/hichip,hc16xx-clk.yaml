## Documentation/devicetree/bindings/clock/hichip,hc16xx-clk.yaml
```yaml
# SPDX-License-Identifier: (GPL-2.0-only OR BSD-2-Clause)
%YAML 1.2
---
$id: http://devicetree.org/schemas/clock/hichip,hc16xx-clk.yaml#
$schema: http://devicetree.org/meta-schemas/core.yaml#

title: HiChip HC16xx Clock Controller

maintainers:
  - Siarhei Volkau <lis8215@gmail.com>

description: |
  The HC16xx clock controller provides known
  clocks for peripherals integrated into HiChip HC16xx SoCs.
  Future revisions will extend supported clocks and add new
  ones.
  The clock controller provides:

    - external oscillator input
    - fixed-factor clocks
    - peripheral gate clocks
    - CPU clock selection

properties:
  compatible:
    enum:
      - hichip,hc16xx-clk

  reg:
    maxItems: 1

  "#clock-cells":
    const: 1

  clocks:
    maxItems: 1
    description:
      External crystal oscillator, typically 24MHz.

  clock-names:
    items:
      - const: hosc

required:
  - compatible
  - reg
  - "#clock-cells"
  - clocks
  - clock-names

additionalProperties: false

examples:
  - |
    #include <dt-bindings/clock/hichip,hc16xx-clock.h>

    hosc: oscillator {
        compatible = "fixed-clock";
        #clock-cells = <0>;
        clock-frequency = <24000000>;
    };

    clock-controller@b8800000 {
        compatible = "hichip,hc16xx-clk";
        reg = <0xb8800060 0x20>;

        clocks = <&hosc>;
        clock-names = "hosc";

        #clock-cells = <1>;
    };
```

## Documentation/devicetree/bindings/gpio/hichip,hc16xx-gpio.yaml
```yaml
# SPDX-License-Identifier: GPL-2.0-only OR BSD-2-Clause
%YAML 1.2
---
$id: http://devicetree.org/schemas/gpio/hichip,hc16xx-gpio.yaml#
$schema: http://devicetree.org/meta-schemas/core.yaml#

title: HiChip HC16xx GPIO controller

maintainers:
  - Siarhei Volkau <lis8215@gmail.com>

description: |
  GPIO controller found in HiChip HC16xx SoCs.

  The controller provides four GPIO banks of 32 GPIOs each:
    - left   GPIOs 0..31
    - bottom GPIOs 32..63
    - right  GPIOs 64..95
    - top    GPIOs 96..127

  Each bank has its own register block. GPIO interrupts from all four
  banks are combined into a single interrupt line.

properties:
  compatible:
    const: hichip,hc16xx-gpio

  reg:
    items:
      - description: Left GPIO bank
      - description: Bottom GPIO bank
      - description: Right GPIO bank
      - description: Top GPIO bank

  reg-names:
    items:
      - const: left
      - const: bottom
      - const: right
      - const: top

  interrupts:
    maxItems: 1

  interrupt-controller: true

  "#interrupt-cells":
    const: 2

  gpio-controller: true

  "#gpio-cells":
    const: 2

  gpio-ranges:
    maxItems: 1

required:
  - compatible
  - reg
  - reg-names
  - interrupts
  - interrupt-controller
  - "#interrupt-cells"
  - gpio-controller
  - "#gpio-cells"
  - gpio-ranges

additionalProperties: false

examples:
  - |
    gpio: gpio-controller@18800044 {
        compatible = "hichip,hc16xx-gpio";

        reg = <0x18800044 0x1c>,
              <0x188000c4 0x1c>,
              <0x188000e4 0x1c>,
              <0x18800344 0x1c>;
        reg-names = "left", "bottom", "right", "top";

        gpio-controller;
        #gpio-cells = <2>;

        gpio-ranges = <&pinctrl 0 0 128>;

        interrupt-parent = <&intc>;
        interrupts = <0>;

        interrupt-controller;
        #interrupt-cells = <2>;
    };
```

## Documentation/devicetree/bindings/input/gpio-serializer-keys.yaml
```yaml
# SPDX-License-Identifier: GPL-2.0-only OR BSD-2-Clause

%YAML 1.2
---
$id: http://devicetree.org/schemas/input/gpio-serializer-keys.yaml#
$schema: http://devicetree.org/meta-schemas/core.yaml#

title: GPIO serializer keys

maintainers:
  - Siarhei Volkau <lis8215@gmail.com>

description: |
  GPIO-connected keyboard serializer driver.

  The device provides a set of keys whose states are read sequentially
  through a GPIO-controlled serial interface.

  Two interface variants are supported.

  The 3-wire variant uses separate GPIOs for latch, clock and data.

  The 2-wire variant combines latch and data into a single bidirectional
  open-drain GPIO. The combined line is driven low by the host during
  the latch operation and is released while reading the serialized
  key states. The serializer may drive the line low to report a key
  state.

properties:
  compatible:
    const: gpio-serializer-keys

  clock-gpios:
    maxItems: 1
    description:
      GPIO connected to the serializer clock input.

  data-gpios:
    maxItems: 1
    description:
      GPIO connected to the serializer data output.

      For a 2-wire serializer this is a bidirectional open-drain line
      shared between the host and the serializer.

  latch-gpios:
    maxItems: 1
    description:
      GPIO connected to the serializer latch input.

      If this property is omitted, the device uses the 2-wire
      latch/data interface.

  num-clocks:
    $ref: /schemas/types.yaml#/definitions/uint32
    minimum: 1
    description:
      Number of serial clock positions processed during each scan.

      A clock position does not have to correspond to a key. The
      serializer may have unused positions, and only positions
      described by child nodes are reported as input keys.

  poll-interval:
    $ref: /schemas/types.yaml#/definitions/uint32
    minimum: 1
    description:
      Initial polling interval in milliseconds.

  latch-duration:
    $ref: /schemas/types.yaml#/definitions/uint32
    minimum: 1
    default: 12
    description:
      Duration of the latch pulse in microseconds.

  clock-period:
    $ref: /schemas/types.yaml#/definitions/uint32
    minimum: 1
    default: 6
    description:
      Delay between consecutive clock operations in microseconds.

  sampling-delay:
    $ref: /schemas/types.yaml#/definitions/uint32
    minimum: 0
    default: 3
    description:
      Delay between a clock operation and sampling the data GPIO,
      in microseconds.

  autorepeat:
    type: boolean
    description:
      Enable input event autorepeat.

  label:
    description:
      Human-readable name of the input device.

patternProperties:
  "^key@[0-9a-f]+$":
    type: object

    properties:
      reg:
        $ref: /schemas/types.yaml#/definitions/uint32
        description:
          Zero-based serial clock position associated with this key.

      linux,code:
        $ref: /schemas/types.yaml#/definitions/uint32
        description:
          Linux input event code reported when the key changes state.

    required:
      - reg
      - linux,code

    additionalProperties: false

required:
  - compatible
  - clock-gpios
  - data-gpios
  - num-clocks
  - poll-interval

additionalProperties: false

examples:
  - |
    #include <dt-bindings/gpio/gpio.h>
    #include <dt-bindings/input/input.h>

    keyboard {
        compatible = "gpio-serializer-keys";

        clock-gpios = <&gpio 11 GPIO_ACTIVE_HIGH>;
        data-gpios  = <&gpio 12 GPIO_ACTIVE_LOW>;
        latch-gpios = <&gpio 10 GPIO_ACTIVE_HIGH>;

        num-clocks = <12>;
        poll-interval = <16>;

        key@0 {
            reg = <0>;
            linux,code = <KEY_B>;
        };

        key@1 {
            reg = <1>;
            linux,code = <KEY_Y>;
        };

        key@2 {
            reg = <2>;
            linux,code = <KEY_SELECT>;
        };

        key@3 {
            reg = <3>;
            linux,code = <KEY_START>;
        };

        key@4 {
            reg = <4>;
            linux,code = <KEY_UP>;
        };

        key@5 {
            reg = <5>;
            linux,code = <KEY_DOWN>;
        };

        key@6 {
            reg = <6>;
            linux,code = <KEY_LEFT>;
        };

        key@7 {
            reg = <7>;
            linux,code = <KEY_RIGHT>;
        };

        key@8 {
            reg = <8>;
            linux,code = <KEY_A>;
        };

        key@9 {
            reg = <9>;
            linux,code = <KEY_X>;
        };

        key@a {
            reg = <10>;
            linux,code = <KEY_LEFTSHIFT>;
        };

        key@b {
            reg = <11>;
            linux,code = <KEY_RIGHTSHIFT>;
        };
    };

  - |
    #include <dt-bindings/gpio/gpio.h>
    #include <dt-bindings/input/input.h>

    keyboard {
        compatible = "gpio-serializer-keys";

        clock-gpios = <&gpio 11 GPIO_ACTIVE_LOW>;
        data-gpios = <&gpio 9 (GPIO_ACTIVE_LOW | GPIO_OPEN_DRAIN)>;

        num-clocks = <12>;
        poll-interval = <16>;

        key@0 {
            reg = <0>;
            linux,code = <KEY_B>;
        };

        key@3 {
            reg = <3>;
            linux,code = <KEY_START>;
        };

        key@7 {
            reg = <7>;
            linux,code = <KEY_RIGHT>;
        };

        key@11 {
            reg = <11>;
            linux,code = <KEY_RIGHTSHIFT>;
        };
    };
```

## Documentation/devicetree/bindings/interrupt-controller/hichip,hc16xx-intc.yaml
```yaml
# SPDX-License-Identifier: (GPL-2.0-only OR BSD-2-Clause)
%YAML 1.2
---
$id: http://devicetree.org/schemas/interrupt-controller/hichip,hc16xx-intc.yaml#
$schema: http://devicetree.org/meta-schemas/core.yaml#

title: HiChip HC16xx secondary interrupt controller

maintainers:
  - Siarhei Volkau <lis8215@gmail.com>

description: |
  Secondary, chained interrupt controller found on HiChip HC16xx SoCs.
  It multiplexes a bank of SoC interrupt sources - each with its own
  polarity/status/enable bits, plus one summarized mailbox interrupt.
  It routes them onto two lines (EIRQ2, EIRQ3) of the MIPS CPU interrupt
  controller (mti,cpu-interrupt-controller) with hardwired priorities.

allOf:
  - $ref: /schemas/interrupt-controller.yaml#

properties:
  compatible:
    const: hichip,hc16xx-intc

  reg:
    maxItems: 1

  interrupt-controller: true

  "#interrupt-cells":
    const: 1

  interrupts:
    description:
      The two parent interrupt lines this controller is chained on.
    items:
      - description: Higher priority parent EIRQ line on the MIPS CPU interrupt controller
      - description: Lower priority parent EIRQ line on the MIPS CPU interrupt controller

required:
  - compatible
  - reg
  - interrupt-controller
  - "#interrupt-cells"
  - interrupts

additionalProperties: false

examples:
  - |
    interrupt-controller@18800020 {
        compatible = "hichip,hc16xx-intc";

        interrupt-controller;
        #interrupt-cells = <1>;

        interrupt-parent = <&cpuintc>;
        interrupts = <3>, <2>;

        reg = <0x18800020 0x24>;
    };
```

## Documentation/devicetree/bindings/phy/hichip,hc16xx-usb-phy.yaml
```yaml
# SPDX-License-Identifier: GPL-2.0-only
%YAML 1.2
---
$id: http://devicetree.org/schemas/phy/hichip,hc16xx-usb-phy.yaml#
$schema: http://devicetree.org/meta-schemas/core.yaml#

title: HiChip HC16XX USB 2.0 PHY

maintainers:
  - Siarhei Volkau <lis8215@gmail.com>

description:
  The HiChip HC16XX USB PHY provides the analog USB 2.0 physical
  interface for the HC16XX MUSB USB controller.

  The PHY contains registers for USB high-speed signal tuning and
  disconnect threshold configuration. The Linux driver currently
  configures the USB disconnect threshold voltage during PHY
  initialization.

properties:
  compatible:
    const: hichip,hc16xx-usb-phy

  reg:
    maxItems: 1

required:
  - compatible
  - reg

additionalProperties: false

examples:
  - |
    usb0phy: phy@18845000 {
        compatible = "hichip,hc16xx-usb-phy";
        reg = <0x18845000 0x24>;
        #phy-cells = <0>;
    };

  - |
    usb1phy: phy@18845100 {
        compatible = "hichip,hc16xx-usb-phy";
        reg = <0x18845100 0x24>;
        #phy-cells = <0>;
    };
```

## Documentation/devicetree/bindings/pinctrl/hichip,hc16xx-pinctrl.yaml
```yaml
# SPDX-License-Identifier: (GPL-2.0-only OR BSD-2-Clause)
%YAML 1.2
---
$id: http://devicetree.org/schemas/pinctrl/hichip,hc16xx-pinctrl.yaml#
$schema: http://devicetree.org/meta-schemas/core.yaml#

title: HiChip HC16xx Pin Controller

maintainers:
  - Siarhei Volkau <lis8215@gmail.com>

description: |
  The HiChip HC16xx pin controller provides pin multiplexing and
  configurable output drive strength for up to 128 GPIO pins.

  The pins are organized into four banks of 32 pins:

    L00-L31
    B00-B31
    R00-R31
    T00-T31

  Each pin has an 8-bit configuration register. The low four bits
  select the pin multiplexing function and the high four bits select
  the output drive strength.

properties:
  compatible:
    const: hichip,hc16xx-pinctrl

  reg:
    maxItems: 1

patternProperties:
  "^[a-zA-Z0-9][a-zA-Z0-9,_-]*$":
    type: object
    additionalProperties: false
    description: Pin configuration node.

    properties:
      function:
        description: |
          Pin multiplexing function to select for all pins in this
          configuration node.
        type: string

      pins:
        description: |
          List of pins to configure. Pin names consist of a bank
          letter followed by a pin number from 0 to 31.
        type: array
        minItems: 1
        items:
          type: string
          pattern: '^[lLbBrRtT](?:[0-9]|[12][0-9]|3[01])$'

      drive-strength:
        description: |
          Output drive strength in milliamps. The HC16xx driver maps
          values 1 through 16 mA to hardware values 0 through 15.
        enum: [1, 2, 3, 4, 5, 6, 7, 8,
               9, 10, 11, 12, 13, 14, 15, 16]

    required:
      - function
      - pins

required:
  - compatible
  - reg

additionalProperties: false

examples:
  - |
    pinctrl@188004a0 {
        compatible = "hichip,hc16xx-pinctrl";
        reg = <0x188004a0 0x100>;

        uart0_pins: uart0-pins {
            function = "uart0";
            pins = "l12", "l13";
        };

        i2c0_pins: i2c0-pins {
            function = "i2c0";
            pins = "l6", "l7";
        };

        i2c1_pins: i2c1-pins {
            function = "i2c1";
            pins = "b0", "b1";
            drive-strength = <8>;
        };
    };

...
```

## Documentation/devicetree/bindings/pwm/hichip,hc16xx-pwm.yaml
```yaml
# SPDX-License-Identifier: (GPL-2.0-only OR BSD-2-Clause)
%YAML 1.2
---
$id: http://devicetree.org/schemas/pwm/hichip,hc16xx-pwm.yaml#
$schema: http://devicetree.org/meta-schemas/core.yaml#

title: HiChip HC16XX PWM controller

maintainers:
  - Siarhei Volkau <lis8215@gmail.com>

description: |
  The HiChip HC16XX PWM controller provides six "independent"
  PWM channels.

  "Independent" because PWM0 must be enabled when any other
  channel is enabled. Therefore, PWM0 is handled specially
  by the driver. Also they all use single clock source divider
  and in company with low bits counters it became a headache
  to select a divider, thus untouched in the driver.

properties:
  compatible:
    const: hichip,hc16xx-pwm

  reg:
    maxItems: 1

  clocks:
    maxItems: 1

  '#pwm-cells':
    const: 3

required:
  - compatible
  - reg
  - clocks
  - '#pwm-cells'

additionalProperties: false

examples:
  - |
    pwm: pwm@18818410 {
        compatible = "hichip,hc16xx-pwm";
        reg = <0x18818410 0x24>;
        clocks = <&clk HC16XX_CLK_SB_27M>;
        #pwm-cells = <3>;
    };
```
