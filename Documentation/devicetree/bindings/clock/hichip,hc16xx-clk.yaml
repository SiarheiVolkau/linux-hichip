## Documentation/devicetree/bindings/reset/hichip,hc16xx-reset.yaml
```yaml
# SPDX-License-Identifier: GPL-2.0-only OR BSD-2-Clause
%YAML 1.2
---
$id: http://devicetree.org/schemas/reset/hichip,hc16xx-reset.yaml#
$schema: http://devicetree.org/meta-schemas/core.yaml#

title: HiChip HC16XX Reset Controller

maintainers:
  - Siarhei Volkau <lis8215@gmail.com>

description: |
  The HiChip HC16XX reset controller provides reset control for
  various SoC peripherals.

  Reset lines are implemented as active-high bits in two system
  reset registers. A reset operation asserts the corresponding bit,
  waits for the peripheral-specific reset duration, and then
  deasserts the bit.

  The reset controller uses one reset cell containing the reset ID
  defined in dt-bindings/reset/hichip,hc16xx-reset.h.

properties:
  compatible:
    const: hichip,hc16xx-reset

  reg:
    maxItems: 1

  "#reset-cells":
    const: 1

required:
  - compatible
  - reg
  - "#reset-cells"

additionalProperties: false

examples:
  - |
    reset: reset-controller@18800080 {
        compatible = "hichip,hc16xx-reset";
        reg = <0x18800080 0x08>;
        #reset-cells = <1>;
    };
```

## Documentation/devicetree/bindings/timer/hichip,hc16xx-timer.yaml
```yaml
# SPDX-License-Identifier: GPL-2.0-only OR BSD-2-Clause
%YAML 1.2
---
$id: http://devicetree.org/schemas/timer/hichip,hc16xx-timer.yaml#
$schema: http://devicetree.org/meta-schemas/core.yaml#

title: HiChip HC16XX System Timer

maintainers:
  - Siarhei Volkau <lis8215@gmail.com>

description: |
  System timer found in HiChip HC16XX SoCs.

  The timer provides:

    * a 32-bit free-running counter used as a clocksource and sched_clock;
    * a compare register generating timer interrupts;
    * a one-shot clockevent device.

allOf:
  - $ref: timer/timer.yaml#

properties:
  compatible:
    const: hichip,hc16xx-timer

  reg:
    maxItems: 1

  interrupts:
    maxItems: 1

  clocks:
    maxItems: 1

  clock-names:
    const: counting

required:
  - compatible
  - reg
  - interrupts
  - clocks
  - clock-names

additionalProperties: false

examples:
  - |
    timer@12040040 {
        compatible = "hichip,hc16xx-timer";
        reg = <0x18818a40 0x10>;
        interrupts = <22>;

        clocks = <&clk HC16XX_CLK_TIMER>;
        clock-names = "counting";
    };
...
```

## Documentation/devicetree/bindings/usb/hichip,hc16xx-musb.yaml
```yaml
# SPDX-License-Identifier: (GPL-2.0-only OR BSD-2-Clause)
%YAML 1.2
---
$id: http://devicetree.org/schemas/usb/hichip,hc16xx-musb.yaml#
$schema: http://devicetree.org/meta-schemas/core.yaml#

title: HiChip HC16XX MUSB USB controller

maintainers:
  - Siarhei Volkau <lis8215@gmail.com>

description:
  The HiChip HC16XX USB controller is based on the Mentor MUSB
  dual-role USB controller. OTG mode is not supported yet.

properties:
  compatible:
    const: hichip,hc16xx-musb

  reg:
    maxItems: 1

  interrupts:
    minItems: 1
    maxItems: 2

  interrupt-names:
    minItems: 1
    items:
      - const: mc
      - const: dma

  clocks:
    maxItems: 1

  resets:
    maxItems: 1

  phys:
    maxItems: 1

  dr_mode:
    enum:
      - host
      - peripheral

required:
  - compatible
  - reg
  - interrupts
  - interrupt-names
  - clocks
  - resets
  - phys

additionalProperties: false

examples:
  - |
    usb0: usb@18844000 {
        compatible = "hichip,hc16xx-musb";
        reg = <0x18844000 0x1000>;

        interrupt-parent = <&intc>;
        interrupts = <53>, <52>;
        interrupt-names = "mc", "dma";

        clocks = <&clk HC16XX_CLK_USB0>;
        resets = <&reset HC16XX_USB0_RESET>;
        phys = <&usb0phy>;

        dr_mode = "peripheral";
    };
```

## arch/mips/configs/sf3000_defconfig
```kconfig
CONFIG_DEFAULT_HOSTNAME="sf3k"
CONFIG_NO_HZ_IDLE=y
CONFIG_HIGH_RES_TIMERS=y
CONFIG_PROFILING=y
CONFIG_MACH_HICHIP_SOC=y
CONFIG_MIPS_RAW_APPENDED_DTB=y
CONFIG_MIPS_CMDLINE_DTB_EXTEND=y
CONFIG_JUMP_LABEL=y
CONFIG_PARTITION_ADVANCED=y
CONFIG_DEVTMPFS=y
CONFIG_DEVTMPFS_MOUNT=y
CONFIG_REGULATOR=y
CONFIG_REGULATOR_FIXED_VOLTAGE=y
CONFIG_VFAT_FS=y
CONFIG_SQUASHFS=y
CONFIG_SQUASHFS_FILE_DIRECT=y
CONFIG_SQUASHFS_4K_DEVBLK_SIZE=y
CONFIG_SQUASHFS_EMBEDDED=y
CONFIG_SQUASHFS_FRAGMENT_CACHE_SIZE=0
CONFIG_NLS_CODEPAGE_437=y
CONFIG_NLS_ISO8859_1=y
CONFIG_PANIC_ON_OOPS=y
CONFIG_SERIAL_8250_CONSOLE=y
CONFIG_HC16XX_IRQ=y
CONFIG_COMMON_CLK_HC16XX=y
CONFIG_HC16XX_TIMER=y
CONFIG_PINCTRL_HC16XX=y
CONFIG_GPIO_HC16XX=y
```

## arch/mips/hichip/Kconfig
```kconfig
# SPDX-License-Identifier: GPL-2.0

choice
	prompt "Machine type"
	depends on MACH_HICHIP_SOC
	default HC16XX_SF3000

config HC16XX_SF3000
	bool "Data Frog SF3000"

endchoice
```

## drivers/gpu/drm/hichip/Kconfig
```kconfig
# SPDX-License-Identifier: GPL-2.0-only
config DRM_HICHIP_DE
	tristate "HiChip Display Engine"
	depends on DRM && OF
	depends on (COMPILE_TEST || MACH_HICHIP)
	select DRM_CLIENT_SELECTION
	select DRM_KMS_HELPER
	select DRM_GEM_DMA_HELPER
	help
	  Chose this option if you have an HiChip HC15xx or HC16xx
	  SOC Display Engine (aka DE).

	  If M is selected this module will be called hichip-de.
```
